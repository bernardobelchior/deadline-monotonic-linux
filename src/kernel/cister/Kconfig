## src/kernel/cister/Kconfig
```kconfig
menu "CISTER framework"
	config CISTER_FRAMEWORK
	bool "CISTER Framework"
	default y

	config CISTER_TRACING
	bool "CISTER tracing"
	default y
	depends on CISTER_FRAMEWORK
	
	config CISTER_SCHED_DM_POLICY
	bool "CISTER scheduling policy:DM"
	default y
	depends on CISTER_FRAMEWORK
endmenu
```
